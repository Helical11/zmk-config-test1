## config/boards/shields/test1/Kconfig.defconfig
```kconfig
if SHIELD_TEST1

    config ZMK_KEYBOARD_NAME
    default "test1"

    config PWM
    default y

    config LED_PWM
    default y

endif
```
