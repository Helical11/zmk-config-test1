#include <behaviors.dtsi>
#include <dt-bindings/zmk/keys.h>
#include <dt-bindings/zmk/outputs.h>
#include <dt-bindings/zmk/backlight.h>

/ {
    keymap {
        compatible = "zmk,keymap";

        default_layer {
            bindings = <
                &kp A
                &out OUT_BLE
                &bt BT_CLR
            >;
        };

        bt_layer {
            bindings = <
                &bootloader
                &bt BT_CLR
                &bt BT_SEL 0
            >;
        };
    };
};